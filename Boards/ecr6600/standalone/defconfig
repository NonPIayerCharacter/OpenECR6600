## Boards/ecr6600/standalone/defconfig
```kconfig
#
# Build Setup
#

#
# Build Setup
#
CONFIG_OUTPUT_FORMAT_ELF=y
CONFIG_LD_SCRIPT_XIP=y
# CONFIG_LD_SCRIPT_RAM is not set
CONFIG_OUTPUT_VERSION_STANDALONE_ELF=y
# CONFIG_OUTPUT_VERSION_TRANSPORT_ELF is not set
# CONFIG_OUTPUT_VERSION_LIB is not set
CONFIG_OPTION_ARCHOPTIMIZATION="-Os"
CONFIG_BUILD_WARNING_ALL=y
# end of Build Setup

#
# Chip Features
#

#
# Chip Features
#
CONFIG_ECR6600=y

#
# ECR6600 CHIP Fetures
#
CONFIG_CPU_ARCH="andes"
# CONFIG_CPU_CLK_SRC_96M is not set
CONFIG_CPU_CLK_SRC_160M=y
# CONFIG_CPU_CLK_SRC_240M is not set
# CONFIG_CPU_CLK_SRC_40m is not set
CONFIG_CPU_CLK_FREQ_DIV_0=y
# CONFIG_CPU_CLK_FREQ_DIV_2 is not set
# CONFIG_CPU_CLK_FREQ_DIV_4 is not set
# CONFIG_CPU_CLK_FREQ_DIV_8 is not set
CONFIG_CPU_ICACHE_ENABLE=y
CONFIG_CPU_DCACHE_ENABLE=y
# end of ECR6600 CHIP Fetures

CONFIG_PSM_SURPORT=y
# CONFIG_PSM_SUPER_LOWPOWER is not set
CONFIG_WIFI_TWT=y
# end of Chip Features

#
# RTOS Features
#

#
# RTOS Configuration Start
#
CONFIG_FREERTOS=y
CONFIG_RTOS="freertos"

#
# RTOS Debug Configuration
#
# CONFIG_TASK_IRQ_SWITCH_TRACE is not set
# CONFIG_HEAP_BOUNDARY_CHECK is not set
# CONFIG_HEAP_CHECK_WHEN_TASK_SWITCHING is not set
CONFIG_FREERTOS_configCHECK_FOR_STACK_OVERFLOW=0
# CONFIG_HEAP_DEBUG is not set
# CONFIG_RUNTIME_DEBUG is not set
# CONFIG_TASK_IRQ_RUN_NUM is not set
# CONFIG_FLASH_DUMP is not set
# CONFIG_SYSTEM_IRQ is not set
CONFIG_OS_TICK_COMPENSTATION=y
# end of RTOS Debug Configuration

#
# RTOS Configuration End
#
# end of RTOS Features

#
# Device Drivers
#

#
# soc drivers
#

#
# UART_NUM
#
CONFIG_CLI_UART_0=y
# CONFIG_CLI_UART_1 is not set
# CONFIG_CLI_UART_2 is not set
CONFIG_SAME_TO_CLI_UART_NUM=y
# CONFIG_AMT_UART_1 is not set
# CONFIG_AMT_UART_2 is not set
# CONFIG_AT_UART_1 is not set
# CONFIG_AT_UART_2 is not set
# end of UART_NUM

CONFIG_UART=y
CONFIG_PIT=y
CONFIG_GPIO=y
CONFIG_DMA=y
CONFIG_AES=y
CONFIG_HASH=y
CONFIG_TRNG=y
# CONFIG_SDIO_SLAVE is not set
# CONFIG_SDHCI is not set
# CONFIG_SDCARD is not set
CONFIG_PWM=y
CONFIG_TIMER=y
CONFIG_EFUSE=y

#
# FLASH Driver Support
#
CONFIG_FLASH=y
# CONFIG_STANDARD_SPI is not set
# CONFIG_DUAL_SPI is not set
CONFIG_QUAD_SPI=y
CONFIG_SPI_CLK_DIV_0=y
# CONFIG_SPI_CLK_DIV_2 is not set
# CONFIG_SPI_CLK_DIV_4 is not set
# CONFIG_SPI_CLK_DIV_6 is not set
# CONFIG_SPI_CLK_DIV_8 is not set
# CONFIG_SPI_CLK_DIV_10 is not set

#
# FLASH Manufacturer's Support
#
CONFIG_FLASH_ALL_COMPATIBILITY=y
CONFIG_FLASH_GD=y
CONFIG_FLASH_PUYA=y
CONFIG_FLASH_ZB=y
CONFIG_FLASH_XM=y
CONFIG_FLASH_XT=y
CONFIG_FLASH_FM=y
CONFIG_FLASH_HUABANG=y
CONFIG_FLASH_EN=y
CONFIG_FLASH_TH=y
CONFIG_FLASH_BOYA=y
# end of FLASH Manufacturer's Support
# end of FLASH Driver Support

# CONFIG_IR is not set
CONFIG_ADC=y
# CONFIG_I2C is not set
# CONFIG_I2S is not set
CONFIG_RTC=y
# CONFIG_SPI_MASTER is not set
# CONFIG_SPI_SLAVE is not set
CONFIG_WDT=y
# CONFIG_WDT_FEED_TASK is not set
# CONFIG_ANALYZE_REBOOT_TYPE is not set
CONFIG_ECC=y
CONFIG_ENCRYPT_LOCK=y
CONFIG_PROCESS_SENSOR=y

#
# Driver UNIT TEST Support
#
# CONFIG_DRV_UNIT_TEST is not set
# end of Driver UNIT TEST Support
# end of Device Drivers

#
# Components Features
#
# CONFIG_CLI is not set
# CONFIG_CMD_SHOW is not set
# CONFIG_CMD_READ is not set
# CONFIG_CMD_WRITE is not set
# CONFIG_CMD_HEALTH_MONITOR is not set
# CONFIG_CMD_ADC_HARDWARE is not set
# CONFIG_CMD_BLE is not set
# CONFIG_BLE_EMB_PRESENT is not set
# CONFIG_CMD_WIFI is not set
# CONFIG_CMD_WIFI_AMT_VERSION is not set
# CONFIG_CMD_WDT is not set
# CONFIG_CMD_SYSTEM_DEBUG is not set
# CONFIG_CMD_SNTP is not set
# CONFIG_CMD_PSM is not set
# CONFIG_CMD_NV is not set
# CONFIG_CMD_EFUSE is not set
# CONFIG_CMD_LA is not set
# CONFIG_CMD_SDCARD is not set
CONFIG_PHREAD=y
CONFIG_LWIP=y
# CONFIG_IPV6 is not set
CONFIG_LWIP_MEM_SIZE=25892
CONFIG_LWIP_TCP_SND_BUF=17520
CONFIG_LWIP_TCP_WND_BUF=8760
CONFIG_NV=y
CONFIG_WIRELESS_WPA_SUPPLICANT=y
CONFIG_ECR6600_DBGTRIM=y
CONFIG_WIRELESS_WPA3_SUPPORT=y
CONFIG_SYSTEM_WIFI_CTRL=y
CONFIG_WIFI_LOG_LEVEL_DEBUG=y
# CONFIG_WIFI_LOG_LEVEL_INFO is not set
# CONFIG_WIFI_LOG_LEVEL_WARN is not set
# CONFIG_WIFI_LOG_LEVEL_ERROR is not set
# CONFIG_WIFI_LOG_LEVEL_RAW is not set
# CONFIG_WIFI_LOG_LEVEL_NONE is not set
CONFIG_WIFI_USER_RECV_BUF_SIZE=65536
CONFIG_WIFI_DRV_RECV_BUF_SIZE=12288
CONFIG_WIFI_AMPDU_TX_CNT=3
CONFIG_MBEDTLS=y
# CONFIG_WIRELESS_IPERF_3 is not set
# CONFIG_WIFI_SMARTCONFIG is not set
# CONFIG_SNTP is not set
# CONFIG_BLE_TUYA_ADAPTER_TEST is not set
# CONFIG_FATFS is not set
# CONFIG_TELNET is not set
# CONFIG_URLPARSER is not set
# CONFIG_CUSTOM_FHOSTAPD is not set
CONFIG_HEALTH_MONITOR=y
CONFIG_HEALTH_MON_TASK_MAX_NUM=16
CONFIG_HEALTH_MON_DEBUG=y
# end of Components Features

CONFIG_COMP_AES=y
CONFIG_COMP_DEBUG_BLE=y
CONFIG_COMP_ECC_P256=y
CONFIG_COMP_H4TL=y
CONFIG_COMP_RF=y
CONFIG_COMP_RWIP=y
CONFIG_MULTIPLEX_UART=y
CONFIG_ECR6600_WIFI=y
CONFIG_FULLMASK=y
CONFIG_WIFI_PRODUCT_FHOST=y
CONFIG_WIFI_PRODUCT="fhost"
CONFIG_WIFI_UMAC=y
CONFIG_WIFI_FHOST=y
CONFIG_WIFI_PLATFORM_VIRTEX7=y
CONFIG_WIFI_PLATFORM="virtex7"
CONFIG_WIFI_VIF=4
CONFIG_WIFI_STA=8
CONFIG_WIFI_MAC_VERSION21=y
CONFIG_WIFI_MAC_VERSION=21
CONFIG_WIFI_MDM_V30=y
CONFIG_WIFI_MDM_VERSION=30
CONFIG_WIFI_IPC_V11=y
CONFIG_WIFI_IPC_VERSION=11
CONFIG_WIFI_TXDESC0=4
CONFIG_WIFI_TXDESC1=64
CONFIG_WIFI_TXDESC2=4
CONFIG_WIFI_TXDESC3=64
CONFIG_WIFI_TXDESC4=4
CONFIG_WIFI_DPSM=y
CONFIG_WIFI_UF=y
CONFIG_WIFI_MON_DATA=y
CONFIG_WIFI_REC=y
CONFIG_WIFI_BCN=y
CONFIG_WIFI_AMSDURX=12
CONFIG_WIFI_SPC=16
CONFIG_WIFI_BFMEE=y
CONFIG_WIFI_BWLEN=y
CONFIG_WIFI_KEYCFG=y
CONFIG_WIFI_MESH_VIF=0
CONFIG_WIFI_MESH_LINK=2
CONFIG_MESH_PATH=5
CONFIG_MESH_PROXY=5
CONFIG_WIFI_P2P=0
CONFIG_WIFI_MURX=y
CONFIG_ONLY_HSU=y
CONFIG_WIFI_HSU=2
CONFIG_WIFI_CMON=y
CONFIG_WIFI_MROLE=y
CONFIG_WIFI_HWSCAN=y
CONFIG_WIFI_AUTOBCN=y
CONFIG_WIFI_HE=y
CONFIG_WIFI_BARX=4
CONFIG_WIFI_REORDBUF=4
CONFIG_WIFI_BATX=4
CONFIG_WIFI_MFP=y
CONFIG_WIFI_AMT_VERSION=y
CONFIG_COMP_DEBUG_WIFI=y
CONFIG_ECR6600_WIFI_DBG_LEVEL0=y
CONFIG_ECR6600_WIFI_DBG_LEVEL=0
CONFIG_CRM=y
CONFIG_IPC_DMA=y
CONFIG_INTC=y
CONFIG_IPC_FHOST=y
CONFIG_WIFIPHY=y
CONFIG_WIFI_PHY_CUSTOM_RF=y
CONFIG_WIFI_PHY_TYPE="custom_rf"
CONFIG_SYSCTRL=y
CONFIG_TIME=y
CONFIG_ASIC_RF=y

#
# Application Configuration
#
CONFIG_BLE_EXAMPLES_NONE=y
# CONFIG_BLE_EXAMPLES_NETCFG_SLAVE is not set
# CONFIG_BLE_TUYA_ADAPTER is not set

#
# SPI_SERVICE
#
# CONFIG_SPI_SERVICE is not set
# end of SPI_SERVICE
# end of Application Configuration

#
# ref design specific Configuration
#
CONFIG_OTA=y
CONFIG_OTA_LOCAL=y
# CONFIG_OTA_SERVICE is not set
CONFIG_OTA_COMPRESSION_UPDATE=y
# CONFIG_OTA_DIFFERENTIAL_UPDATE is not set
# CONFIG_OTA_AB_UPDATE is not set
CONFIG_OTA_MODE_STRING="OTA_COMPRESSION_UPDATE"
# end of ref design specific Configuration
```

## drivers/drivers/flash/Kconfig
```kconfig
menu "FLASH Driver Support"

config FLASH
	bool "FLASH Driver Support"
	default y

if FLASH
choice
	prompt "SPI MODE Selection"
	default STANDARD_SPI
	
	config STANDARD_SPI
		bool "Standard spi"

	config DUAL_SPI
		bool "Dual spi"

	config QUAD_SPI
		bool "Quad spi"
endchoice

choice
	prompt "SPI Clock Frequency Division"
	default SPI_CLK_DIV_0

	config SPI_CLK_DIV_0
		bool "FREQ_DIV_0"

	config SPI_CLK_DIV_2
		bool "FREQ_DIV_2"

	config SPI_CLK_DIV_4
		bool "FREQ_DIV_4"

	config SPI_CLK_DIV_6
		bool "FREQ_DIV_6"

	config SPI_CLK_DIV_8
		bool "FREQ_DIV_8"

	config SPI_CLK_DIV_10
		bool "FREQ_DIV_10"
endchoice

menu "FLASH Manufacturer's Support"

config FLASH_ALL_COMPATIBILITY
	bool "FLASH all select"
	default y
	select FLASH_GD
	select FLASH_PUYA
	select FLASH_ZB
	select FLASH_XM
	select FLASH_XT
	select FLASH_FM
	select FLASH_HUABANG
	select FLASH_EN
	select FLASH_TH
	select FLASH_BOYA
	select FLASH_GT
	select FLASH_KH
	#GD25Q80E,GD25Q16E 

config FLASH_GD
	bool "FLASH_GD"
	#GD25Q80E,GD25Q16E,GD28Q32E,GD25Q128E 
		
config FLASH_PUYA
	bool "FLASH_PUYA"
	#P25Q80HD,P25Q16H,P25Q16SH,P25Q32H 
	
config FLASH_ZB
	bool "FLASH_ZB"
	#ZB25VQ80,ZB25VQ16,ZB25VQ32,ZB25VQ64,ZB25VQ128 

config FLASH_XM
	bool "FLASH_XM"
	#XM25QH80B,XM25QH16B,XM25QH16C,XM25QH32B,XM25QH64C 
		
config FLASH_XT
	bool "FLASH_XT"
	#XT25F08B,XT25F16B,XT25F16F,XT25F32F,XT25F64F
		
config FLASH_FM
	bool "FLASH_FM"
	#FM25QH16B 
	
config FLASH_HUABANG
	bool "FLASH_HUABANG"
	#W25Q32JV 
	
config FLASH_EN
	bool "FLASH_EN"
	#EN25Q16B,EN25QH32B,EN25Q32C 
	
config FLASH_TH
	bool "FLASH_TH"
	#TH25Q16HB 
	
config FLASH_BOYA
	bool "FLASH_BOYA"
	#BY25Q32CS

config FLASH_GT
	bool "FLASH_GT"
	#GT25Q16A,GT25Q32A

config FLASH_KH
	bool "FLASH_KH"
	#KH25L128,KH25L64
	
endmenu # menu "FLASH Manufacturer's Support"

endif

endmenu # menu "SPI Flash Support"
```
