## Boards/Kconfig
```kconfig
comment "Chip Features"

config ECR6600
	bool
	select CLI
	default y

if ECR6600
	menu "ECR6600 CHIP Fetures"
		source "Boards/ecr6600/common/Kconfig"
	endmenu

	comment "PSM Configuration Start"
	menuconfig PSM_SURPORT
        	bool "PSM SURPORT surport"
        	default y
            	source "Boards/ecr6600/common/psm/Kconfig"
	comment "PSM Configuration End"
	
	comment "BLE Configuration Start"
	menuconfig ECR_BLE
        	bool "Bluetooth Low Energy Fetures"
        	default y
        	source "PS/ble/Kconfig"
	comment "BLE Configuration End"

	config CPP
    		bool "CPP Support"
    		default n
endif
```

## PS/ble/master/Kconfig
```kconfig
config ECR_BLE
      bool
      default y

config BLE_APP_ECR
      bool
      default y

config BLE_APP
      bool
      default y

config COMP_AES
      bool
      default y

config COMP_DEBUG_BLE
      bool
      default y

config COMP_ECC_P256
      bool
      default y

config COMP_H4TL
      bool
      default y

config COMP_RF
      bool
      default y

config COMP_RWIP
      bool
      default y

config BLE_RF_EXTRC
      bool
      default y

config BLE_PRODUCT_BLEFULL
      bool
      default y

config BLE_PRODUCT
      string
      default "ble-full"

config BLE_BUBBLE
      bool
      default y

config BLE_ROLE_ALL
      bool
      default y

config BLE_ROLE
      string
      default "all"

config LE_ACT
      int
      default 3

config LE_CONN
      int
      default 1

config BLE_HCITL
      bool
      default y

config MULTIPLEX_UART
      bool
      default y

config BLE_ATTC
      bool
      default y

config BLE_ATTS
      bool
      default y

config BLE_SEC_CON
      int
      default 32

config BLE_NBPRF
      int
      default 1

config BLE_PROFILES
      bool
      default y

config BLE_WLCOEX
      bool
      default y

config BLE_RAL
      int
      default 1

config BLE_EMB_PRESENT
      bool
      default y

config BLE_HOST_PRESENT
      bool
      default y

config BLE_AHI_PRESENT
      bool
      default y

config BLE_SCH_PRESENT
      bool
      default y
```

## PS/nobp/Kconfig
```kconfig
config ECR6600_WIFI
      bool
      default y

config FULLMASK
      bool
      default y

config WIFI_PRODUCT_FHOST
      bool
      default y

config WIFI_PRODUCT
      string
      default "fhost"

config WIFI_UMAC
      bool
      default y

config WIFI_FHOST
      bool
      default y

config WIFI_STA_SURPORT
      bool
      default y

config WIFI_PLATFORM_VIRTEX7
      bool
      default y

config WIFI_PLATFORM
      string
      default "virtex7"

config WIFI_VIF
      int
      default 4

config WIFI_STA
      int
      default 8

config WIFI_MAC_VERSION21
      bool
      default y

config WIFI_MAC_VERSION
      int
      default 21

config WIFI_MDM_V30
      bool
      default y

config WIFI_MDM_VERSION
      int
      default 30

config WIFI_IPC_V11
      bool
      default y

config WIFI_IPC_VERSION
      int
      default 11

config WIFI_TXDESC0
      int
      default 4

config WIFI_TXDESC1
      int
      default 64

config WIFI_TXDESC2
      int
      default 4

config WIFI_TXDESC3
      int
      default 64

config WIFI_TXDESC4
      int
      default 4

config WIFI_UF
      bool
      default y

config WIFI_MON_DATA
      bool
      default y

config WIFI_REC
      bool
      default y

config WIFI_BCN
      bool
      default y

config WIFI_AMSDURX
      int
      default 12

config WIFI_SPC
      int
      default 16

config ENHANCE_11B_CCI_BY_SW
      bool
      default y

config WIFI_BFMEE
      bool
      default y

config WIFI_BWLEN
      bool
      default y

config WIFI_KEYCFG
      bool
      default y

config WIFI_MESH_VIF
      int
      default 0

config WIFI_MESH_LINK
      int
      default 2

config MESH_PATH
      int
      default 5

config MESH_PROXY
      int
      default 5

config WIFI_P2P
      int
      default 0

config WIFI_MURX
      bool
      default y

config ONLY_HSU
      bool
      default y

config WIFI_HSU
      int
      default 2

config WIFI_CMON
      bool
      default y

config WIFI_MROLE
      bool
      default y

config WIFI_HWSCAN
      bool
      default y

config WIFI_AUTOBCN
      bool
      default y

config WIFI_HE
      bool
      default y

config WIFI_BARX
      int
      default 8

config WIFI_REORDBUF
      int
      default 4

config WIFI_BATX
      int
      default 4

config WIFI_MFP
      bool
      default y

config WIFI_MESH_LIB
      bool
      default y

config WIFI_LMAC_TEST
      bool
      default y

config WIFI_AMT_VERSION
      bool
      default y

config COMP_DEBUG_WIFI
      bool
      default y

config ECR6600_WIFI_DBG_LEVEL0
      bool
      default y

config ECR6600_WIFI_DBG_LEVEL
      int
      default 0

config CRM
      bool
      default y

config IPC_DMA
      bool
      default y

config INTC
      bool
      default y

config IPC_FHOST
      bool
      default y

config WIFIPHY
      bool
      default y

config WIFI_PHY_CUSTOM_RF
      bool
      default y

config WIFI_PHY_TYPE
      string
      default "custom_rf"

config SYSCTRL
      bool
      default y

config TIME
      bool
      default y

config ASIC_RF
      bool
      default y

config FUNC_TRIM
      bool
      default y

config BLE_FIXED_AGC_GAIN
      bool
      default y
```

## apps/Kconfig
```kconfig
source "apps/ble_apps/Kconfig"
#source "apps/spi_service/Kconfig"
source "apps/xsl/Kconfig"
source "apps/jd/Kconfig"
source "apps/tencent/Kconfig"
#source "apps/qthsdk/Kconfig"
#source "apps/ai_sys/gx8006/Kconfig"
#source "apps/ai_sys/joyinside/Kconfig"
#source "apps/ai_sys/coze/Kconfig"
#source "apps/ai_sys/qzt/Kconfig"
#source "apps/aws/Kconfig"
```

## apps/ble_apps/Kconfig
```kconfig
choice 
	prompt "BLE Test Applications"
	depends on ECR_BLE && BLE_PRODUCT_BLEFULL

	config BLE_EXAMPLES_NONE
		bool "no ble examples"

	config BLE_EXAMPLES_NETCFG_SLAVE
		depends on BLE_PRODUCT_BLEFULL
		bool "ble netcfg example as slave"

	config BLE_EXAMPLES_SPI_SERVER
		depends on BLE_PRODUCT_BLEFULL
		bool "ble spi server"

	config BLE_EXAMPLES_BLUFI
		depends on BLE_PRODUCT_BLEFULL
		bool "blufi netcfg process"
endchoice

if BLE_EXAMPLES_BLUFI
config AT_BLE_BLUFI_TIMEOUT_MIN
	int "The minimum timeout time(sec) for BLUFI in AT"
	default 120
    
config AT_BLE_BLUFI_TIMEOUT_MAX
	int "The maximum timeout time(sec) for BLUFI in AT"
	default 180
endif
```

## components/Kconfig
```kconfig
#source "components/cli/Kconfig"
source "components/cmd/Kconfig"
#source "components/lvgl/Kconfig.eswin"
source "components/pthread/Kconfig"
source "components/lwip/Kconfig"
source "components/nv/Kconfig"
source "components/wpa/Kconfig"
source "components/wifi_ctrl/Kconfig"
source "components/mbedtls/Kconfig"
source "components/iperf3/Kconfig"
#source "components/cjson/Kconfig"
source "components/smartconfig/Kconfig"
source "components/ak/Kconfig"
source "components/sntp/Kconfig"
source "components/ble_ctrl/Kconfig"
source "components/fs/Kconfig"
source "components/telnet/Kconfig"
source "components/url_parser/Kconfig"
#source "components/mqtt/Kconfig"
source "components/hostapd_ioctl/Kconfig"
source "components/health_monitor/Kconfig"
source "components/http_server/Kconfig"
source "components/http_client/Kconfig"
source "components/web_config/Kconfig"
source "components/webserver_config/Kconfig"
source "components/trs-tls/Kconfig"
source "components/modbus/Kconfig"
source "components/websocket_client/Kconfig"
source "components/wifi_netcfg/Kconfig"
source "components/transport_tcp/Kconfig"
#source "components/matter/Kconfig"
source "components/ewss/Kconfig"
#source "components/opus/Kconfig"
source "components/wifi_mesh/Kconfig"
#source "components/nfc/Kconfig"
#source "components/aw21024/Kconfig"
#source "components/aw20054/Kconfig"
source "components/voice_chip/Kconfig"
#source "components/codec/Kconfig"
#source "components/libogg-1.3.6/Kconfig"
```

## components/ak/Kconfig
```kconfig
menuconfig WIFI_AIRKISS
	bool "Wifi AirKiss Config Component Support"
	depends on WIFI_SMARTCONFIG
	default n
```

## components/cmd/Kconfig
```kconfig
menuconfig CMD
	bool "CMD Component Support"
	default y
	
if CMD
	source "components/cmd/cmd_core/cmd_core_cli/Kconfig"
	source "components/cmd/cmd_core/cmd_core_at/Kconfig"
endif
```

## components/cmd/cmd_core/cmd_core_at/Kconfig
```kconfig
menuconfig CMD_AT
	bool "CMD_AT Component Support"
	default n
	
if CMD_AT
	source "components/cmd/cmd_core/cmd_core_at/fatfs_command/Kconfig"
endif
```

## components/cmd/cmd_core/cmd_core_cli/Kconfig
```kconfig
menuconfig CLI
	bool "CLI Component Support"
	default y
	
if CLI
	source "components/cmd/cmd_core/cmd_core_cli/command/Kconfig"
endif
```

## components/ewss/Kconfig
```kconfig
menuconfig EWSS
	bool "EWSS Wi-Fi Zeroconfig Support"
	depends on ECR6600_WIFI
	default n
	if EWSS
		config EWSS_CLI
		bool "EWSS CLI Support"
		default y
	endif
```

## components/fs/Kconfig
```kconfig
menuconfig FATFS
	bool "FATFS Component Support"
	select SDCARD
	default n
menuconfig LFS
	bool "LittleFS Component Support"
	select NV
	default n
	help
		Enable littlefs on the SPI flash partition named "fs".
```

## components/http_client/Kconfig
```kconfig
menuconfig HTTP_CLIENT
	bool "HTTP Client Support"
	default n

if HTTP_CLIENT
	config HTTP_REDIRECT_BUILD
	bool "HTTP REDIRECT BUILD"
	default y
endif
```

## components/mbedtls/Kconfig
```kconfig
menu "MBEDTLS"

	config MBEDTLS
		bool "MBEDTLS Component Support"
		depends on LWIP
		default y

	config MBEDTLS_HAVE_TIME
		bool "Use RTC time for mbedTLS"
		depends on MBEDTLS && RTC
		default n

	config MBEDTLS_HAVE_TIME_DATE
		bool "Check certificate validity periods using RTC"
		depends on MBEDTLS && RTC
		select MBEDTLS_HAVE_TIME
		default n
		help
			Set UTC time through RTC or SNTP before certificate authentication.

	config MBEDTLS_KEY_EXCHANGE_PSK
		bool "Enable TLS 1.2 PSK cipher suites"
		depends on MBEDTLS_SSL_PROTO_TLS1_2
		default n

	config MBEDTLS_SSL_PROTO_TLS1_2
		bool "Support TLS 1.2 protocol"
		depends on MBEDTLS
		default y
		
	config MBEDTLS_SSL_PROTO_TLS1_3
		bool "Support TLS 1.3 protocol"
		depends on MBEDTLS
		select MBEDTLS_HKDF_C
		default n

	config MBEDTLS_SSL_PROTO_DTLS
		bool "Support DTLS protocol"
		depends on MBEDTLS
		select MBEDTLS_SSL_PROTO_TLS1_2
		default n
		help
			Enable support for DTLS (Datagram TLS) protocol.
			This is required for applications that need PSK (Pre-Shared Key) support.
			Note: DTLS requires TLS 1.2 to be enabled.

	menu "TLS 1.3 related configurations"
		depends on MBEDTLS_SSL_PROTO_TLS1_3

		config MBEDTLS_SSL_TLS1_3_COMPATIBILITY_MODE
			bool "TLS 1.3 middlebox compatibility mode"
			default y

		config MBEDTLS_SSL_TLS1_3_KEY_EXCHANGE_MODE_PSK_ENABLED
			bool "TLS 1.3 PSK key exchange mode"
			default y

		config MBEDTLS_SSL_TLS1_3_KEY_EXCHANGE_MODE_EPHEMERAL_ENABLED
			bool "TLS 1.3 ephemeral key exchange mode"
			default y

		config MBEDTLS_SSL_TLS1_3_KEY_EXCHANGE_MODE_PSK_EPHEMERAL_ENABLED
			bool "TLS 1.3 PSK ephemeral key exchange mode"
			default y
	endmenu

	config MBEDTLS_DEBUG
		bool "Enable mbedTLS debugging"
		depends on MBEDTLS
		default n
		help
			Enable mbedTLS debugging functions at compile time.
			If this option is enabled, you can include
			"mbedtls/esp_debug.h" and call mbedtls_esp_enable_debug_log()
			at runtime in order to enable mbedTLS debug output via the ESP
			log mechanism.

	choice MBEDTLS_DEBUG_LEVEL
		bool "Set mbedTLS debugging level"
		depends on MBEDTLS_DEBUG
		default MBEDTLS_DEBUG_LEVEL_VERBOSE
		help
			Set mbedTLS debugging level

		config MBEDTLS_DEBUG_LEVEL_WARN
			bool "Warning"
		config MBEDTLS_DEBUG_LEVEL_INFO
			bool "Info"
		config MBEDTLS_DEBUG_LEVEL_DEBUG
			bool "Debug"
		config MBEDTLS_DEBUG_LEVEL_VERBOSE
			bool "Verbose"
	endchoice

	config MBEDTLS_DEBUG_LEVEL
		int
		default 1 if MBEDTLS_DEBUG_LEVEL_WARN
		default 2 if MBEDTLS_DEBUG_LEVEL_INFO
		default 3 if MBEDTLS_DEBUG_LEVEL_DEBUG
		default 4 if MBEDTLS_DEBUG_LEVEL_VERBOSE

	config MBEDTLS_TLS_SERVER
		bool "Enable mbedTLS srv"
		depends on MBEDTLS
		default y
		help
			Allow to act as an SSL/TLS server

	config MBEDTLS_TLS_CLIENT
		bool "Enable mbedTLS cli"
		depends on MBEDTLS
		default y
		help
			Allow to act as an SSL/TLS client
endmenu
```

## components/modbus/Kconfig
```kconfig
menu "MODBUS"

    config MODBUS
		bool "MODBUS Component Support"
		depends on LWIP
		default n

	menu "MODBUS related configurations"
		depends on MODBUS

		config MODBUS_RTU
			bool "Support MODBUS_RTU"
			depends on MODBUS
			default n

		config MODBUS_ASSIC
			bool "Support MODBUS_ASSIC"
			depends on MODBUS
			default n

		config MODBUS_TCP
			bool "Support MODBUS_TCP"
			depends on MODBUS
			default y
	endmenu

	menu "MODBUS DEBUG"
		depends on MODBUS

		config MODBUS_TCP_DEBUG
			bool "Support MODBUS_TCP_DEBUG"
			depends on MODBUS
			default n
	endmenu

endmenu
```

## components/mqtt/Kconfig
```kconfig
menuconfig MQTT
	bool "MQTT Component Support"
	default n
	select TRANSPORT_TCP
	select MBEDTLS
	select URLPARSER

config MQTT_SSL
	bool "MQTT SSL Support"
	depends on MQTT
	default n

config MQTT_ENABLE_WS
	bool "MQTT ENABLE WS"
	depends on MQTT
	default n

config MQTT_ENABLE_WSS
	bool "MQTT ENABLE WSS"
	depends on MQTT
	default n

config MQTT_PROTOCOL_5
	bool "MQTT PROTOCOL 5 Support"
	depends on MQTT
	default n
```

## components/transport_tcp/Kconfig
```kconfig
menuconfig TRANSPORT_TCP
	bool "Transport TCP Support"
	select MBEDTLS
	select TRS_TLS
	select PTHREAD
	default n
```

## components/voice_chip/Kconfig
```kconfig
menuconfig VOICE_CHIP
	bool "Voice chip"
	default n
	help
	  Shared hardware voice chip abstraction for board-level codec or
	  offload-audio devices.

if VOICE_CHIP

choice VOICE_CHIP_BACKEND
	prompt "Voice chip backend"
	default VOICE_CHIP_ES8311

config VOICE_CHIP_ES8311
	bool "ES8311 voice chip backend"
	help
	  Build the shared ES8311 board codec control backend used by
	  Coze and JoyInside.

config VOICE_CHIP_GX8006
	bool "GX8006 voice chip backend"
	help
	  Build the shared GX8006 voice chip backend and service bridge
	  used by Tomcat and future GX8006-based products.

config CI1302
	bool "CI1302 PCM UART voice chip backend"
	select UART_DMA_LOOPLIST_RX

endchoice

if VOICE_CHIP_GX8006
	config SMARTBOT_FLOWCTRL_USING_IO
		bool "io flow control"
		default n

	config GX8006_EXAMPLES
		bool "gx8006 examples"
		default n
endif

if CI1302

config CI1302_UART_BAUDRATE
	int "CI1302 UART baud rate"
	range 115200 2000000
	default 921600

config CI1302_AUTO_INIT
	bool "Initialize CI1302 at startup"
	default n
	help
	  Legacy board startup option. New applications should call
	  voice_chip_service_start() from a task after the scheduler starts.

config CI1302_CLI
	bool "CI1302 raw driver diagnostic CLI"
	default n
	depends on CLI

endif
endif
```

## components/webserver_config/Kconfig
```kconfig
menuconfig WEBSERVER_CONFIG
	bool "WEB server support"
	select HTTPSERVER
	default n
	if WEBSERVER_CONFIG

		config WEB_CAPTIVE_PORTAL_ENABLE
		bool "WEB server captive portal support"
		default n

	endif
```

## components/websocket_client/Kconfig
```kconfig
menuconfig WEB_SOCKET_CLIENT
	bool "Web Socket Client Component Support"
	select TRANSPORT_TCP
	select URLPARSER
	default n
```

## components/wifi_mesh/Kconfig
```kconfig
menuconfig WIFI_MESH
	bool "Wifi mesh Component Support"
	default n
	select LWIP_NAPT
	select IPV6

if WIFI_MESH
	choice
	prompt "set wifi mesh log level"
	default WIFI_MESH_LOG_LEVEL_DEBUG

	config WIFI_MESH_LOG_LEVEL_DEBUG
	bool "debug"
	
	config WIFI_MESH_LOG_LEVEL_INFO
	bool "info"

	config WIFI_MESH_LOG_LEVEL_WARN
	bool "warnning"

	config WIFI_MESH_LOG_LEVEL_ERROR
	bool "error"

	config WIFI_MESH_LOG_LEVEL_NONE
	bool "none"
	endchoice
endif
```
